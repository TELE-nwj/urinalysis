## scend sol版本/firmware-tests/mobile-ap-smoke/sdkconfig.defaults
```kconfig
CONFIG_IDF_TARGET="esp32s3"
CONFIG_HTTPD_WS_SUPPORT=y
CONFIG_HTTPD_WS_PRE_HANDSHAKE_CB_SUPPORT=y
CONFIG_HTTPD_WS_POST_HANDSHAKE_CB_SUPPORT=y
```

## third/测试版/sdkconfig.defaults
```kconfig
CONFIG_IDF_TARGET="esp32s3"
CONFIG_HTTPD_WS_SUPPORT=y
CONFIG_HTTPD_WS_PRE_HANDSHAKE_CB_SUPPORT=y
CONFIG_HTTPD_WS_POST_HANDSHAKE_CB_SUPPORT=y
CONFIG_NIAIO_AP_SSID="NIAIO-Monitor"
CONFIG_NIAIO_AP_PASSWORD="niaio-v1-test"
```

## third_logtest_20261012/main/Kconfig.projbuild
```kconfig
menu "NIAIO 手机连接"
    config NIAIO_AP_SSID
        string "设备 Wi-Fi 热点名称"
        default "NIAIO-Monitor"
    config NIAIO_AP_PASSWORD
        string "设备 Wi-Fi 密码（8～63 个 ASCII 字符）"
        default "niaio-v1-test"
        help
            开发测试凭据，请在正式使用前修改。
endmenu
```

## 手机与上位机/安卓App/esp32/main/Kconfig.projbuild
```kconfig
menu "NIAIO mobile connection"
    config NIAIO_AP_SSID
        string "Device Wi-Fi SSID"
        default "NIAIO-Monitor"
    config NIAIO_AP_PASSWORD
        string "Device Wi-Fi password (8..63 ASCII characters)"
        default "niaio-v1-test"
        help
            Development credential. Change before production use.
endmenu
```
